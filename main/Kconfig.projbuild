## main/Kconfig.projbuild
```kconfig
menu "ESP32 POC Wi-Fi"

config POC_HTTPD_WS_SUPPORT
    bool
    default y
    select HTTPD_WS_SUPPORT

config POC_WIFI_SSID
    string "Wi-Fi SSID"
    default ""
    help
        SSID of the Wi-Fi network to join in station mode.

config POC_WIFI_PASSWORD
    string "Wi-Fi password"
    default ""
    help
        Password for the Wi-Fi network. Leave empty for an open network.

endmenu
```
